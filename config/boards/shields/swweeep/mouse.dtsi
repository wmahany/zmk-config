#define ZMK_MOUSE_DEFAULT_MOVE_VAL 1500  // 600
#define ZMK_MOUSE_DEFAULT_SCRL_VAL 20    // 10

#include <dt-bindings/zmk/mouse.h>

#undef SCROLL_UP
#undef SCROLL_DOWN
#undef SCROLL_LEFT
#undef SCROLL_RIGHT
#define M_WH_U SCROLL_Y(U_MOUSE_SCROLL_MAX)
#define M_WH_D SCROLL_Y(-U_MOUSE_SCROLL_MAX)
#define M_WH_L SCROLL_X(-U_MOUSE_SCROLL_MAX)
#define M_WH_R SCROLL_X(U_MOUSE_SCROLL_MAX)

&mmv {
  acceleration-exponent = <1>;      // 1
  time-to-max-speed-ms = <500>;    // 1500
  delay-ms = <0>;                   // 0
};

&msc {
  acceleration-exponent = <1>;      // 0
  time-to-max-speed-ms = <40>;      // 5000
  delay-ms = <0>;                   // 10
};

